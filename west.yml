## west.yml
```yaml
manifest:
  remotes:
    - name: ncs
      url-base: https://github.com/nrfconnect
  projects:
    - name: nrf
      repo-path: sdk-nrf
      remote: ncs
      revision: v3.3.0
      import: true
    - name: zephyr-my-boards
      url: https://github.com/fgervais/zephyr-my-boards
      revision: cd7a749c6e566bc427fc868232c1f22608cd42cc
      path: myboards
    - name: zephyr-mymodule-base
      url: https://github.com/fgervais/zephyr-mymodule-base.git
      revision: b164117a24400be3a7f78ec22273d2b01f74641c
      path: mymodules/base
  self:
    path: application
```
